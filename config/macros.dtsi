macro_tmux: macro_tmux{
  compatible = "zmk,behavior-macro";
  label = "macro_tmux";
  #binding-cells = <0>;
  bindings = <&kp LC(S)>;
};

macro_alfred: macro_alfred{
  compatible = "zmk,behavior-macro";
  label = "macro_alfred";
  #binding-cells = <0>;
  bindings = <&kp LG(SPACE)>;
};
